## CMakeLists.txt
```
# SPDX-License-Identifier: Apache-2.0

cmake_minimum_required(VERSION 3.20.0)

find_package(Zephyr REQUIRED HINTS $ENV{ZEPHYR_BASE})
project(bootlab_version_demo)

target_sources(app PRIVATE src/main.c)

target_compile_definitions(app PRIVATE BUILD_VERSION="${BUILD_VERSION}")
```

## prj.conf
```kconfig
CONFIG_PRINTK=y
CONFIG_BOOTLOADER_MCUBOOT=y
CONFIG_BUILD_OUTPUT_BIN=y
CONFIG_BUILD_OUTPUT_HEX=y
CONFIG_MCUBOOT_EXTRA_IMGTOOL_ARGS="--pad-header"
```

## src/main.c
```c
/*
 * Copyright (c) 2026 BootLab contributors
 * SPDX-License-Identifier: Apache-2.0
 */

#include <zephyr/kernel.h>
#include <zephyr/sys/printk.h>

/* BUILD_VERSION is expected to be passed via CMAKE extra flags. */
#ifndef BUILD_VERSION
#define BUILD_VERSION "unknown"
#endif

int main(void)
{
    printk("BootLab Zephyr version demo\n");
    printk("BUILD_VERSION=%s\n", BUILD_VERSION);
    return 0;
}
```
